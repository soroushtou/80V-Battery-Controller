#include <TimerFour.h>

#include <TimerThree.h>

#include <TimerOne.h>

#include <SPI.h>

#include <SD.h>


// the setup function runs once when you press reset or power the board

int state;          // state of working
int ve;             // ve for engine on or off
int veng;           // v form engine 
double vb;           // v from 80v battery
double io;           // I out  80v battery

//float cs;               //charge state



int i,j,k,p;           //variables used for sorting and getting median from vb
double vb_median,temp;  //variables used for sorting and getting median from vb
double a[49];           //variables used for sorting and getting median from vb

double ESpend;          //Summation of Amper.Hours used
double EspendNonSum;    //Amper.Hours used
double ERemain;         //Amper.Hours remained
double EGen;            //Summation of Amper.Hours generated by Motor Generator
double EgenNonSum;      //Amper.Hours generated by Motor Generator
unsigned int soc;      //percent of charge


unsigned long int last_time=0;
unsigned long n_lcd=0;
unsigned long n_USART=0;
unsigned int n_gen=0;
unsigned int n_start=0;
unsigned int sd_error;


const int SystemIsReady = 22;          //("SYS IS READY")
const int EconomicMode = 24;           //("ECONOMIC MODE")
const int MediumMode = 26;             //("MEDIUM MODE")
const int HighPowerMode = 28;          //("HIGH POWER MODE")
const int EndOfWorking = 30;           //("END OF WORKING")
const int ChargingMode = 32;           //("CHARGING MODE")

String FileName ;
unsigned int FileNum = 0;

const int FuelLed = 8;                  //Fuel LED 
const int FuelRel = 9;                  //Fuel relay
const int StartLed = 10;                //Start LED 
const int StartRel = 11;                //Start relay
const int GenLed = 12;                  //Generator LED 
const int GentRel = 13;                 //Generator relay

//int Bat80 = A0;                 //ADC A0 BAt 80
//int Engon = A1;                 //ADC engine on 
//int Isensor = A2;               //ADC current sensor

const float EFull = 10000;       //meghdare ESpend dar andaze girie avalie
const float VBFull = 85;
const float VBEmpty = 75;

#include <LiquidCrystal.h>

// initialize the library with the numbers of the interface pins
  LiquidCrystal lcd(48, 46, 44, 42, 40, 38);



void setup() {
   ve=0;

   int Bat80 = analogRead(A0);
   vb = Bat80 * (5.0 / 1023.0) * 21.21 ;
   ERemain = ((vb - VBEmpty)/(VBFull - VBEmpty))* EFull;
   ESpend = EFull - ERemain ;

   //unsigned int FileNum=0;
   // initialize serial communication at 9600 bits per second:
  Serial.begin(9600);
  Serial.print("Initializing SD card...");

   if (!SD.begin(53)) {
     Serial.println("initialization failed!");
   }
   else
   {
   Serial.println("initialization done.");

   while(SD.exists(String(FileNum)+".txt")==true)
   {
    FileNum ++ ;
   }

   FileName = String(FileNum) + ".txt";
  File dataFile = SD.open(FileName, FILE_WRITE);
  if (dataFile) {
     //dataFile.println("CLEARDATA"); //clears up any data left from previous projects
     dataFile.println("Time,state,io,vb,vb median,ve,AHgen,AHremained,AHspend,soc");
     //dataFile.println("RESETTIMER"); //resets timer to 0
     dataFile.close();
                }
   }

  
  Serial.println("CLEARDATA");       //clears up any data left from previous projects
  Serial.println("LABEL,Time,state,io,io median,ve,AHspend,AHremained");
  Serial.println("RESETTIMER");      //resets timer to 0
 
   

   Timer1.initialize(100000);
   Timer1.attachInterrupt(sta);
   Timer3.initialize(100000);
   Timer3.attachInterrupt(gen);
   Timer4.initialize(100000);
   Timer4.attachInterrupt(ER);
   
  // initialize digital pin 8-13 as an output.
  pinMode(FuelLed, OUTPUT);
  pinMode(FuelRel, OUTPUT);
  pinMode(StartLed , OUTPUT);
  pinMode(StartRel, OUTPUT);
  pinMode(GenLed, OUTPUT);
  pinMode(GentRel, OUTPUT);
  
  
      digitalWrite(FuelLed, LOW);
      digitalWrite(FuelRel, HIGH);
      digitalWrite(StartLed, LOW);
      digitalWrite(StartRel, HIGH);
      digitalWrite(GenLed, LOW);
      digitalWrite(GentRel, HIGH);
      
      
  //configure pin30-35 as an input and enable the internal pull-up resistor
  pinMode(SystemIsReady, INPUT_PULLUP);
  pinMode(EconomicMode, INPUT_PULLUP);
  pinMode(MediumMode, INPUT_PULLUP);
  pinMode(HighPowerMode, INPUT_PULLUP);
  pinMode(EndOfWorking, INPUT_PULLUP);
  pinMode(ChargingMode, INPUT_PULLUP);
  
  
  // set up the LCD's number of columns and rows: 
  lcd.begin(20, 4);
  
  // Print a message to the LCD.
lcd.clear();
lcd.setCursor(0, 1);
lcd.print("    WELCOME");
delay(100);              // wait for a second
 
  Timer1.stop();
  Timer3.stop();

}


void ER(void)
{
   if(io>0.05){
   EspendNonSum =(vb * io)/ 36000.0;  //(vb_median * io * 0.1 )/ 3600.0;
   ESpend += EspendNonSum ;
   }
   else{
   EspendNonSum = 0; 
   }

   if(ve==1 && digitalRead(GentRel)==LOW){
   EgenNonSum = (vb_median * 0.45 )/ 3600.0;  //vb * 4.5 * 0.001 * millis / 3600  =  0.00000125 * vb * millis
   EGen += EgenNonSum ;  
   }
   else EgenNonSum = 0; 

   ERemain = ERemain - EspendNonSum + EgenNonSum ;


   soc = map(vb_median,76,85,0,100);    // hesab kardane soc 
  
  if(p<=10 && io < 0.1) {         //sorting vb and getting median ( when io = 0 )
    p++;a[p]=vb;
    } 
  else if(p>10){
    for(i=0;i<=5;i++){
    temp=0;
    k=i;
    for(j=i;j<=10;j++){
      if(a[j]>=temp){
        k=j;
        temp=a[j];
      }
    }
    a[k]=a[i];
    a[i]=temp;
  }
  vb_median=a[5];
    p=0;
  }
    
  Serial.print("DATA,TIME,");       //writes the time in the first column A and the time since the measurements started in column B 
  Serial.print(state);
  Serial.print(","); 
  Serial.print(io);
  Serial.print(",");
  Serial.print(vb);
  Serial.print(",");
  Serial.print(vb_median);
  Serial.print(",");
  Serial.print(ve);
  Serial.print(",");
  Serial.print(EGen);
  Serial.print(",");
  Serial.print(ERemain);
  Serial.print(",");
  Serial.print(ESpend);
  Serial.print(",");
  Serial.println(soc);
 
        //String that should be written on micro sd card
        //String dataString = "Time= " + String(millis()) + " State= " + String(state) + " Iout= " + String(io) + " I_median= " + String(vb_median) + " Eng= " + String(ve) + " ESpend= " + String(ESpend) + " AHremained= " + String(soc) ;
        String dataString = String(millis()) + "," + String(state) + "," + String(io) + "," + String(vb) + "," + String(vb_median) + "," + String(ve) + "," + String(EGen) + "," + String(ERemain) + "," + String(ESpend) + "," + String(soc) ; 
        // open the file. note that only one file can be open at a time,
        // so you have to close this one before opening another.
        File dataFile = SD.open(FileName, FILE_WRITE);

        // if the file is available, write to it:
        if (dataFile) {
        dataFile.println(dataString);
        dataFile.close();
        sd_error=0;
        }
        else{
            sd_error=1;
            Serial.println("SD ERROR");
            }
    }


void sta(void)   // delay for start
{  
  if(n_start>=80){
  digitalWrite(StartLed, HIGH);
  digitalWrite(StartRel, LOW);
  
  Timer1.stop();
  }
  n_start ++ ;
}


void gen(void)
{                                              //delay for gen
  if(n_gen>=80){
  digitalWrite(GenLed, HIGH);
  digitalWrite(GentRel, LOW);
  
  Timer3.stop();
  }
  n_gen ++ ;
}


void sort(void){         //sorting function
  for(i=0;i<=5;i++){
    temp=0;
    k=i;
    for(j=i;j<=10;j++){
      if(a[j]>=temp){
        k=j;
        temp=a[j];
      }
    }
    a[k]=a[i];
    a[i]=temp;
  }
  vb_median=a[5];
}


void loop() {


  // read the input on analog pin 0,1,2:
  int Bat80 = analogRead(A0);
  int Engon = analogRead(A1);
  float Isensor = analogRead(A2);
  
  int veng = Engon * (5.0 / 1023.0);
  if(veng >= 2 && ve==0){ve=1;}                // assuming engine is on 

  if (ve==0) {vb = Bat80 * (5.0 / 1023.0) * 21.21 ;}                                        //vaghti motor khamooshe , vb max bayad = 80v bashad
  if (ve==1) {vb = Bat80 * (5.0 / 1023.0) *21.21 ;}                                        //vaghti motor roshane , vb max bayad = 90v bashad
  

  io = ((Isensor * 200.0 / 1023.0)) ;                          // 33 is the resistance 
         
//vb_median=80;     
  // lcd up date       
    if ((millis() / 1000)>n_lcd) {
      n_lcd ++;

      lcd.clear();
      
       if (digitalRead(SystemIsReady)==LOW){state=1; lcd.setCursor(0,0); lcd.print("SYS IS READY");}
       if (digitalRead(EconomicMode)==LOW){state=2; lcd.setCursor(0,0); lcd.print("ECONOMIC MODE");}
       if (digitalRead(MediumMode)==LOW){state=3; lcd.setCursor(0,0); lcd.print("MEDIUM MODE");}
       if (digitalRead(HighPowerMode)==LOW){state=4; lcd.setCursor(0,0); lcd.print("HIGHT POWER MODE");}
       if (digitalRead(EndOfWorking)==LOW){state=5; lcd.setCursor(0,0); lcd.print("END OF WORKING");}
       if (digitalRead(ChargingMode)==LOW){state=6; lcd.setCursor(0,0); lcd.print("CHARGING MODE");}
       
       lcd.setCursor(0,1);
       if (ve==1) {lcd.print("ENGINE: ON");}           // eng on
       if (ve==0) {lcd.print("ENGINE:OFF");}           // eng off 
       if (sd_error==1){lcd.print(" SD ERROR");}
       lcd.setCursor(0,2);
       lcd.print("IO=");    lcd.print(io); 
       lcd.print(" ES=");   lcd.print(ESpend);

       lcd.setCursor(0,3);
       lcd.print("VB=");        lcd.print(vb);
       lcd.print(" ER=");       lcd.print(ERemain);

      }


/*  if((millis()/100)>n_USART){
  n_USART ++;
  
  soc = map(vb_median,76,85,0,100);    // hesab kardane soc 

  

  
  
  if(p<=10 && io < 0.1) {         //sorting vb and getting median ( when io = 0 )
    p++;a[p]=vb;
    } 
  else if(p>10){
    sort();
    p=0;
  }
  
  
  Serial.print("DATA,TIME,");       //writes the time in the first column A and the time since the measurements started in column B 
  Serial.print(state);
  Serial.print(","); 
  Serial.print(io);
  Serial.print(",");
  Serial.print(vb);
  Serial.print(",");
  Serial.print(vb_median);
  Serial.print(",");
  Serial.print(ve);
  Serial.print(",");
  Serial.print(EGen);
  Serial.print(",");
  Serial.print(ERemain);
  Serial.print(",");
  Serial.print(ESpend);
  Serial.print(",");
  Serial.println(soc);

 
        //String that should be written on micro sd card
        //String dataString = "Time= " + String(millis()) + " State= " + String(state) + " Iout= " + String(io) + " I_median= " + String(vb_median) + " Eng= " + String(ve) + " ESpend= " + String(ESpend) + " AHremained= " + String(soc) ;
        String dataString = String(millis()) + "," + String(state) + "," + String(io) + "," + String(vb) + "," + String(vb_median) + "," + String(ve) + "," + String(EGen) + "," + String(ERemain) + "," + String(ESpend) + "," + String(soc) ; 
        // open the file. note that only one file can be open at a time,
        // so you have to close this one before opening another.
        File dataFile = SD.open(FileName, FILE_WRITE);

        // if the file is available, write to it:
        if (dataFile) {
        dataFile.println(dataString);
        dataFile.close();
        sd_error=0;
        }
        else{
            sd_error=1;
            Serial.println("SD ERROR");
            }
 
  }
 */
 
  if (digitalRead(SystemIsReady)==LOW )    // SYS IS READY
  {
    state=1;
    n_start=0;
    n_gen = 0;
    ve=0;
    digitalWrite(FuelLed, LOW);
    digitalWrite(FuelRel, HIGH);
    digitalWrite(StartLed, LOW);
    digitalWrite(StartRel, HIGH);
    digitalWrite(GenLed, LOW);
    digitalWrite(GentRel, HIGH);
  }
 

  if (digitalRead(EconomicMode)==LOW )   //ECONOMIC MODE
  {
    state=2;
    
    //digitalWrite(FuelLed, HIGH);
    //digitalWrite(FuelRel, LOW);
       
    if ((ERemain <=6000) && (ve==0))
      {
       digitalWrite(FuelLed, HIGH);
       digitalWrite(FuelRel, LOW);
        n_gen = 0;
        if(n_start == 0)
       {
       n_start = 1;
       Timer1.restart(); 
       } 
      
     
       digitalWrite(GenLed, LOW);
       digitalWrite(GentRel, HIGH); 
      
      }
    
     if ((ve==1))             // ENGINE ON
      {
        
       
       
       n_start=0;
       if(n_gen == 0)
       {
       n_gen = 1;
       Timer3.restart(); 
       }
       
       digitalWrite(StartLed, LOW);
       digitalWrite(StartRel, HIGH);
       //digitalWrite(GenLed, HIGH);
       //digitalWrite(GentRel, HIGH);
      }
      
    if (ERemain >=8000)
      {
      digitalWrite(FuelLed, LOW);
      digitalWrite(FuelRel, HIGH);
      digitalWrite(StartLed, LOW);
      digitalWrite(StartRel, HIGH);
      digitalWrite(GenLed, LOW);
      digitalWrite(GentRel, HIGH); 
      ve=0;
      n_start=0;
      n_gen = 0;
      } 
  }
  
  
 if (digitalRead(MediumMode)==LOW )   //Medium Mode
  {
    state=3;
    
    //digitalWrite(FuelLed, HIGH);
    //digitalWrite(FuelRel, LOW);
       
    if ((ERemain <=7000) && (ve==0))
      {
       n_gen = 0;
       digitalWrite(FuelLed, HIGH);
       digitalWrite(FuelRel, LOW);
       if(n_start == 0)
       {
       n_start = 1;
       Timer1.restart(); 
       } 
             
       digitalWrite(GenLed, LOW);
       digitalWrite(GentRel, HIGH); 
      
      }
    
     if ((ve==1))             // ENGINE ON
      {
        
       
       n_start=0;
       
       if(n_gen == 0)
       {
       n_gen = 1;
       Timer3.restart(); 
       }
       
       digitalWrite(StartLed, LOW);
       digitalWrite(StartRel, HIGH);

      }
      
    if (ERemain >=9000)
      {
      digitalWrite(FuelLed, LOW);
      digitalWrite(FuelRel, HIGH);
      digitalWrite(StartLed, LOW);
      digitalWrite(StartRel, HIGH);
      digitalWrite(GenLed, LOW);
      digitalWrite(GentRel, HIGH);
      ve=0;
      n_start=0;
      n_gen = 0;      
      } 
  }


  if (digitalRead(HighPowerMode)==LOW )   //High Power Mode
  {
    state=4;
    
    //digitalWrite(FuelLed, HIGH);
    //digitalWrite(FuelRel, LOW);
       
    if ((ERemain <=8000) && (ve==0))
      {
       n_gen = 0;
       digitalWrite(FuelLed, HIGH);
       digitalWrite(FuelRel, LOW);
       if(n_start == 0)
       {
       n_start = 1;
       Timer1.restart(); 
       } 
             
       digitalWrite(GenLed, LOW);
       digitalWrite(GentRel, HIGH); 
      
      }
    
     if ((ve==1))             // ENGINE ON
      {
        
       
       n_start=0;
       
       if(n_gen == 0)
       {
       n_gen = 1;
       Timer3.restart(); 
       }
       
       digitalWrite(StartLed, LOW);
       digitalWrite(StartRel, HIGH);

      }
      
    if (ERemain >=9500)
      {
      digitalWrite(FuelLed, LOW);
      digitalWrite(FuelRel, HIGH);
      digitalWrite(StartLed, LOW);
      digitalWrite(StartRel, HIGH);
      digitalWrite(GenLed, LOW);
      digitalWrite(GentRel, HIGH);
      ve=1;
      n_start=0;
      n_gen = 0;      
      } 
  }


  if (digitalRead(EndOfWorking)==LOW )   //End Of Working
  {
    state=5;
    
    //digitalWrite(FuelLed, HIGH);
    //digitalWrite(FuelRel, LOW);
       
    if ((ERemain <=3000) && (ve==0))
      {
       n_gen = 0;
       digitalWrite(FuelLed, HIGH);
       digitalWrite(FuelRel, LOW);
       if(n_start == 0)
       {
       n_start = 1;
       Timer1.restart(); 
       } 
             
       digitalWrite(GenLed, LOW);
       digitalWrite(GentRel, HIGH); 
      
      }
    
     if ((ve==1))             // ENGINE ON
      {
        
       
       n_start=0;
       
       if(n_gen == 0)
       {
       n_gen = 1;
       Timer3.restart(); 
       }
       
       digitalWrite(StartLed, LOW);
       digitalWrite(StartRel, HIGH);

      }
      
    if (ERemain >=10000)
      {
      digitalWrite(FuelLed, LOW);
      digitalWrite(FuelRel, HIGH);
      digitalWrite(StartLed, LOW);
      digitalWrite(StartRel, HIGH);
      digitalWrite(GenLed, LOW);
      digitalWrite(GentRel, HIGH);
      ve = 0;
      n_start=0;
      n_gen = 0;      
      } 
  }


  if (digitalRead(ChargingMode)==LOW )   //Charging Mode
  {
    state=5;
    
    //digitalWrite(FuelLed, HIGH);
    //digitalWrite(FuelRel, LOW);
       
    if ((ERemain <=1000) && (ve==0))
      {
       n_gen = 0;
       digitalWrite(FuelLed, HIGH);
       digitalWrite(FuelRel, LOW);
       if(n_start == 0)
       {
       n_start = 1;
       Timer1.restart(); 
       } 
             
       digitalWrite(GenLed, LOW);
       digitalWrite(GentRel, HIGH); 
      
      }
    
     if ((ve==1))             // ENGINE ON
      {
        
       
       n_start=0;
       
       if(n_gen == 0)
       {
       n_gen = 1;
       Timer3.restart(); 
       }
       
       digitalWrite(StartLed, LOW);
       digitalWrite(StartRel, HIGH);

      }
      
    if (ERemain >=10000)
      {
      digitalWrite(FuelLed, LOW);
      digitalWrite(FuelRel, HIGH);
      digitalWrite(StartLed, LOW);
      digitalWrite(StartRel, HIGH);
      digitalWrite(GenLed, LOW);
      digitalWrite(GentRel, HIGH);
      ve=0;
      n_start=0;
      n_gen = 0;      
      } 
  }  
  
  
  
  }
